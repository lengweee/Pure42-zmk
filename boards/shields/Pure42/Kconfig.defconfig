## boards/shields/Pure42/Kconfig.defconfig
```kconfig
if SHIELD_PURE42_LEFT

config ZMK_KEYBOARD_NAME
    default "Pure42"

config ZMK_SPLIT_ROLE_CENTRAL
    default y

endif

if SHIELD_PURE42_LEFT || SHIELD_PURE42_RIGHT

config ZMK_SPLIT
    default y

endif
```

## boards/shields/Pure42/Kconfig.shield
```kconfig
config SHIELD_PURE42_LEFT
    def_bool $(shields_list_contains,Pure42_left)

config SHIELD_PURE42_RIGHT
    def_bool $(shields_list_contains,Pure42_right)
```
